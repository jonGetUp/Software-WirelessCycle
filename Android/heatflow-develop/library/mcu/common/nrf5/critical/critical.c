/************************************************************************************************************
 * Copyright (C) Hes-so VALAIS/WALLIS, HEI Sion, Infotronics. 2018
 * Created by Thomas Sterren
 * All rights reserved.
 ************************************************************************************************************/

/************************************************************************************************************/
/* Header files                                                                                             */
/************************************************************************************************************/
#include <nrf.h>
#include <app_util_platform.h>
#include "critical.h"

/************************************************************************************************************/
/* Declaration section                                                                                      */
/************************************************************************************************************/
volatile int bOMEnterCriticalRegionNested = 0;

/************************************************************************************************************/
/* --- Extern "C" Section ---                                                                               */
/************************************************************************************************************/
//-----------------------------------------------------------------------------------------------------------
int inIsr()
{
    // Check MCU in interrupt state
    return (__get_IPSR() != 0);
}

//-----------------------------------------------------------------------------------------------------------
void enterCritical()
{
    // Only disable interrupts when not calling from an ISR
    if(!inIsr()) 
    {
        if(!bOMEnterCriticalRegionNested) 
        {
            // Disable interrupts
            __disable_irq();
        }
        bOMEnterCriticalRegionNested++;
    }
}

//-----------------------------------------------------------------------------------------------------------
void exitCritical()
{
    // Only enable interrupts when not calling from an ISR
    if(!inIsr()) 
    {
        bOMEnterCriticalRegionNested--;
        if(!bOMEnterCriticalRegionNested) 
        {
            // Enable interrupts
            __enable_irq();
        }
    }
}
